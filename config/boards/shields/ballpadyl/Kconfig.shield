## config/boards/shields/ballpadyl_left/Kconfig.deconfig
```kconfig
if SHIELD_BALLPADYL

config ZMK_KEYBOARD_NAME
    default "ballpadyl_left"

    endif
```

## config/boards/shields/ballpadyl_left/Kconfig.shield
```kconfig
config SHIELD_BALLPADYL_LEFT
    def_bool $(shields_list_contains, ballpadyl_left)
```
